#include <Adafruit_NeoPixel.h>
#ifdef __AVR__
  #include <avr/power.h>
#endif

#include <stdio.h>
#include <stdlib.h>
#include <unistd.h>

// Which pin on the Arduino is connected to the NeoPixels?
// On a Trinket or Gemma we suggest changing this to 1
#define PIN            6

// How many NeoPixels are attached to the Arduino?
#define NUMPIXELS      WIDTH * HEIGHT
#define WIDTH 16
#define HEIGHT 16

// When we setup the NeoPixel library, we tell it how many pixels, and which pin to use to send signals.
// Note that for older NeoPixel strips you might need to change the third parameter--see the strandtest
// example for more information on possible values.
Adafruit_NeoPixel pixels = Adafruit_NeoPixel(NUMPIXELS, PIN, NEO_GRB + NEO_KHZ800);

#define for_x for (int x = 0; x < WIDTH; x++)
#define for_y for (int y = 0; y < HEIGHT; y++)
#define for_xy for_x for_y

int delayval = 1000;

unsigned univ[HEIGHT][WIDTH] = {
  {0,0,0,0,0,0,0,0,0,0,0,0,0,0,0,0},
  {0,0,0,0,0,0,0,0,0,0,0,0,0,0,0,0},
  {0,0,0,0,0,0,0,0,0,0,0,0,0,0,0,0},
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  {0,0,0,0,0,0,0,0,0,0,0,0,0,0,0,0},
};

void setup() {
    // This is for Trinket 5V 16MHz, you can remove these three lines if you are not using a Trinket
#if defined (__AVR_ATtiny85__)
  if (F_CPU == 16000000) clock_prescale_set(clock_div_1);
#endif
  // End of trinket special code

  pixels.begin(); // This initializes the NeoPixel library. 

}

int calcPosition(int x, int y) {
  int i;
  if (x%2 == 0) {
    i = (x * 16) + (15 - y);
  } else {
    i = (x * 16) + y;
  }
  return i;
}

void show()
{
  for (int x = 0; x < WIDTH; x++) {
    for (int y = 0; y < HEIGHT; y++) {
      pixels.setPixelColor(calcPosition(x,y), pixels.Color(0,0,0));
      if (univ[x][y]) {
        pixels.setPixelColor(calcPosition(x,y), pixels.Color(1,1,1));  
      }
    }
  }
  pixels.show();
}
 
void evolve()
{
	unsigned newUniv[HEIGHT][WIDTH];
 
	for_y for_x {
		int n = 0;
		for (int y1 = y - 1; y1 <= y + 1; y1++)
			for (int x1 = x - 1; x1 <= x + 1; x1++)
				if (univ[(y1 + HEIGHT) % HEIGHT][(x1 + WIDTH) % WIDTH])
					n++;
 
		if (univ[y][x]) n--;
		newUniv[y][x] = (n == 3 || (n == 2 && univ[y][x]));
	}
	for_y for_x univ[y][x] = newUniv[y][x];
}

void loop() {
	show();
	evolve();
	delay(250);
}
